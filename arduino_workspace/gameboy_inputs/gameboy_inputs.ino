/*
 * developing a small app that lets you to finetune and calibrate the joystick / button 
 * analogue conversions, display the results on the screen.
 * 
 * You can copy the hameboy_inputs.h to your code and use it to fetch the gameboy 
 * joystick / button states.
 */


#include <Wire.h>
//#include <stdint.h>
//#include <avr/io.h>
#include "gameboy_inputs.h"


// Pins

// Constants
int const address = 60;
int const commands = 0x00;
int const onecommand = 0x80;
int const data = 0x40;
int const onedata = 0xC0;

// OLED display **********************************************

// Character set for text - stored in program memory
const uint8_t CharMap[96][6] PROGMEM = {
{ 0x00, 0x00, 0x00, 0x00, 0x00, 0x00 }, 
{ 0x00, 0x00, 0x5F, 0x00, 0x00, 0x00 }, 
{ 0x00, 0x07, 0x00, 0x07, 0x00, 0x00 }, 
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{ 0xFF, 0xFF, 0xFF, 0xFF, 0xFF, 0x00 }

};

// Current plot position
int x0;
int y0;

// Write a single command
void Single (uint8_t x) {
  Wire.write(onecommand);
  Wire.write(x);
}
  
void InitDisplay () {
  Wire.beginTransmission(address);
  Wire.write(commands);
  Wire.write(0xA1);  // Flip horizontal
  Wire.write(0xAF);  // Display on
  Wire.endTransmission();
}

void ClearDisplay () {
  for (int p = 0 ; p < 8; p++) {
    Wire.beginTransmission(address);
    Single(0xB0 + p);
    Wire.endTransmission();
    for (int q = 0 ; q < 8; q++) {
      Wire.beginTransmission(address);
      Wire.write(data);
      for (int i = 0 ; i < 20; i++) Wire.write(0);
      Wire.endTransmission();
    }
  }
}
// Move current plot position to x,y
void MoveTo (int x, int y) {
  x0 = x;
  y0 = y;
}



uint8_t ReverseByte (uint8_t x) {
  x = ((x >> 1) & 0x55) | ((x << 1) & 0xaa);
  x = ((x >> 2) & 0x33) | ((x << 2) & 0xcc);
  x = ((x >> 4) & 0x0f) | ((x << 4) & 0xf0);
  return x;    
}

// Plot an ASCII character with bottom left corner at x,y
void PlotChar (int c, int x, int y) {
  int h = y & 0x07;
  for (int p = 0; p < 2; p++) {
    Wire.beginTransmission(address);
    Single(0xB0 + (y >> 3) + p);          // Page
    for (int col=0; col<6; col++) {
      Single(0x00 + ((x+2+col) & 0x0F));  // Column low nibble
      Single(0x10 + ((x+2+col)>>4));      // Column high nibble
      Single(0xE0);                       // Read modify write
      Wire.write(onedata);
      Wire.endTransmission();
      Wire.requestFrom(address, 2);
      Wire.read();                        // Dummy read
      int j = Wire.read();
      Wire.beginTransmission(address);
      Wire.write(onedata);
      int bits = ReverseByte(pgm_read_byte(&CharMap[c-32][col]));
      //Wire.write((bits<<h)>>(p<<3) | j);
      Wire.write((bits<<h)>>(p<<3) );
      Single(0xEE);                       // Cancel read modify write
    }
    Wire.endTransmission();
  }
}

// Plot text starting at the current plot position
void PlotText(char *s) {
  int i=0;
  while (1) {
    char c = s[i];
    if (c == 0) return;
    PlotChar(c, x0, y0);
    x0 = x0 + 6;
    i++;
  }
}



// Setup **********************************************

#define BUZZER 1 

void setup() {
  //analogReference(INTERNAL1V1);
  Wire.begin();
  ClearDisplay();
  InitDisplay();
   pinMode(BUZZER, OUTPUT); 

   MoveTo(0, 55); PlotText("btn1:");
   MoveTo(64, 55); PlotText("btn2:");
   MoveTo(0, 39); PlotText("btn3:");
   MoveTo(80
   , 39); PlotText("r:");
   MoveTo(0, 23); PlotText("jy_x:");
   MoveTo(64, 23);  PlotText("jy_y:");
 
}

char buff[50];

void loop () {
   read_inputs(PB3);
   read_inputs(PB4);
   read_inputs(PB5);
  
   MoveTo(50, 55); sprintf(buff, "%d", button1); PlotText(buff);
   read_inputs(PB3);
   read_inputs(PB4);
   read_inputs(PB5);
   MoveTo(114, 55); sprintf(buff, "%d", button2); PlotText(buff);
   read_inputs(PB3);
   read_inputs(PB4);
   read_inputs(PB5);
   MoveTo(50, 39); sprintf(buff, "%d", button3); PlotText(buff);
   read_inputs(PB3);
   read_inputs(PB4);
   read_inputs(PB5);

   MoveTo(30, 23); sprintf(buff, "%4d", joystick_x); PlotText(buff);
   read_inputs(PB3);
   read_inputs(PB4);
   read_inputs(PB5);
   MoveTo(94, 23);  sprintf(buff, "%4d", joystick_y); PlotText(buff);
   read_inputs(PB3);
   read_inputs(PB4);
   read_inputs(PB5);
   
   MoveTo(20, 0); sprintf(buff, "x:%4d", adc4_btn2_x); PlotText(buff);
   read_inputs(PB3);
   read_inputs(PB4);
   read_inputs(PB5);
   MoveTo(80, 0); sprintf(buff, "y:%4d", adc3_btn1_y); PlotText(buff);
   read_inputs(PB3);
   read_inputs(PB4);
   read_inputs(PB5);
   MoveTo(80, 39); sprintf(buff, "%4d", adc5_btn3); PlotText(buff);


   //tone(BUZZER, 1000);
   // for(int i=0; i<128; i++) {
   //     PlotPoint(i, i % 64);
   // }
   // noTone(BUZZER); 
   // delay(2000);
   // ClearDisplay();
  
}
